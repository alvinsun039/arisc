## ar100s/arch/Kconfig
```kconfig
config CPUX_ARM32
	bool

config CPUX_ARM64
	bool

config OPENRISC
	bool

config RISCV
	bool

config AR100S_OS
	bool

choice PLATFORM
	prompt "Sunxi-chip to use"
	help
	the ic we use for build

config SUN50IW6P1
	bool
	imply CPUX_ARM64
	select OPENRISC
	prompt "AW1728 sun50iw6p1 H6 platform"

config SUN50IW10P1
	bool
	imply CPUX_ARM64
	select OPENRISC
	select AR100S_OS
	prompt "AW1855 sun50iw10p1 A100 platform"

config SUN50IW12P1
	bool
	imply CPUX_ARM64
	select OPENRISC
	select AR100S_OS
	prompt "AW1860 sun50iw12p1 TV303 platform"

config SUN55IW3P1
	bool
	imply CPUX_ARM64
	select OPENRISC
	select AR100S_OS
	prompt "AW1890 sun55iw3p1 A523 platform"

config SUN55IW6P1
	bool
	imply CPUX_ARM64
	select RISCV
	select AR100S_OS
	prompt "AW1903 sun60iw2p1 TI533 platform"

config SUN55IW7P1
	bool
	imply CPUX_ARM64
	select RISCV
	select AR100S_OS
	prompt "AW1938 sun55iw7p1 H628 platform"

config SUN60IW1P1
	bool
	imply CPUX_ARM64
	select OPENRISC
	select AR100S_OS
	prompt "AW1885 sun60iw1p1 T736 platform"

config SUN60IW2P1
	bool
	imply CPUX_ARM64
	select RISCV
	select AR100S_OS
	prompt "AW1903 sun60iw2p1 A733 platform"

config SUN60IW3P1
	bool
	imply CPUX_ARM64
	select RISCV
	select AR100S_OS
	prompt "AW1952 sun60iw3p1 A735 platform"

config SUN65IW1P1
	bool
	imply CPUX_ARM64
	select RISCV
	select AR100S_OS
	prompt "AW1919 sun65iw1p1 A537 platform"

config SUN252IW3P1
	bool
	imply CPUX_ARM64
	select RISCV
	select AR100S_OS
	prompt "AW1932 sun252iw3p1 V883 platform"

config SUN8IW12P1
	bool
	imply CPUX_ARM32
	select OPENRISC
	prompt "AW1721 sun8iw12p1 V5 platform"

config SUN8IW15P1
	bool
	imply CPUX_ARM32
	select OPENRISC
	prompt "AW1755 sun8iw15p1 A50/R311/MR133 platform"

config SUN8IW16P1
	bool
	imply CPUX_ARM32
	select OPENRISC
	prompt "AW1816 sun8iw16p1 V5V200 platform"

endchoice

choice PLATFORM_SELECT
	prompt "Platform used"

config EVB_PLATFORM
	bool "evb platfrom used"

config FPGA_PLATFORM
	bool "fpga platform used"

endchoice

config CHIP_PLATFORM
	string "The name of SUNXI CHIP"
	default "sun50iw6p1" if SUN50IW6P1
	default "sun50iw10p1" if SUN50IW10P1
	default "sun50iw12p1" if SUN50IW12P1
	default "sun55iw3p1" if SUN55IW3P1
	default "sun55iw6p1" if SUN55IW6P1
	default "sun55iw7p1" if SUN55IW7P1
	default "sun60iw1p1" if SUN60IW1P1
	default "sun65iw1p1" if SUN65IW1P1
	default "sun60iw2p1" if SUN60IW2P1
	default "sun252iw3p1" if SUN252IW3P1
	default "sun60iw3p1" if SUN60IW3P1
	default "sun8iw12p1" if SUN8IW12P1
	default "sun8iw15p1" if SUN8IW15P1
	default "sun8iw16p1" if SUN8IW16P1

config ARCH_PLATFORM
	string "The name of SUNXI ARCH"
	default "openrisc" if OPENRISC
	default "riscv" if RISCV
```

## ar100s/driver/Kconfig
```kconfig
menu "Device Drivers"

source "driver/pmu/Kconfig"

source "driver/twi/Kconfig"

source "driver/hwmsgbox/Kconfig"

source "driver/hdmi/Kconfig"

source "driver/timer/Kconfig"

source "driver/watchdog/Kconfig"

source "driver/ir/Kconfig"

source "driver/dram/Kconfig"

source "driver/intc/Kconfig"

source "driver/smc/Kconfig"

source "driver/ndma/Kconfig"

source "driver/gpio_powerkey/Kconfig"

source "driver/gpadc/Kconfig"
endmenu
```

## ar100s/driver/hdmi/Kconfig
```kconfig
config HDMI_USED
	def_bool n
	prompt "HDMI used"

config HDMIRX_USED
	def_bool n
	depends on HDMI_USED
	prompt "HDMIRX used"

config HDMITX_USED
	def_bool n
	depends on HDMI_USED
	prompt "HDMITX used"
```

## ar100s/driver/intc/Kconfig
```kconfig
choice IRQCHIP_IP
	prompt "Sunxi irqchip to use"

config OPENRISC_INTC_USED
	bool
	prompt "openrisc intc used"

config CLIC_USED
	bool
	prompt "clic used"

endchoice
```

## ar100s/driver/pmu/Kconfig
```kconfig
menuconfig PMU_USED
	bool
	prompt "PMU used"
	default y

if PMU_USED

config AXP803_USED
	bool "AXP803 used"

config AXP2202_USED
	bool "AXP2202 used"

config AXP806_USED
	bool "AXP806 used"

config AXP858_USED
	bool "AXP858 used"

config AXP8191_USED
	bool "AXP8191 used"

config AXP1530_USED
	bool "AXP1530 used"

config PMU_EXT_USED
	bool "pmu_ext used"

config PMU_POWER_CHECK
	bool "pmu power check"

config PMU_IRQ_CHECK
	bool "pmu irq check"

endif # PMU_USED

menuconfig BMU_USED
	bool
	prompt "BMU used"
	default n

if BMU_USED

config ETA6973_USED
	bool "bmu eta6973 used"

config AXP519_USED
	bool "bmu axp519 used"

config AXP515_USED
	bool "bmu axp515 used"

config AXP517_USED
	bool "bmu axp517 used"

endif # BMU_USED
```
